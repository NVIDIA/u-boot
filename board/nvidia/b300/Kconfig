## board/nvidia/b300/Kconfig
```kconfig
if TARGET_NVIDIA_B300

config SYS_BOARD
	default "b300"

config SYS_VENDOR
	default "nvidia"

config SYS_CONFIG_NAME
	string "board configuration name"
	default "b300"

endif
```

## board/nvidia/hgxr/Kconfig
```kconfig
if TARGET_NVIDIA_HGXR

config SYS_BOARD
    default "hgxr"

config SYS_VENDOR
    default "nvidia"

config SYS_CONFIG_NAME
    string "board configuration name"
    default "hgxr"

endif
```
