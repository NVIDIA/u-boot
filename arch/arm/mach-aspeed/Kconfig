## arch/arm/mach-aspeed/Kconfig
```kconfig
if ARCH_ASPEED

config SYS_ARCH
	default "arm"

config SYS_SOC
	default "aspeed"

config SYS_TEXT_BASE
	default 0x00000000

choice
	prompt "Aspeed SoC select"
	depends on ARCH_ASPEED
	default ASPEED_AST2500

config ASPEED_AST2400
        bool "Support Aspeed AST2400 SoC"
        select CPU_ARM926EJS
        help
          The Aspeed AST2400 is a ARM-based SoC with arm926ejs CPU.
          It is used as Board Management Controller on many server boards,
          which is enabled by support of LPC and eSPI peripherals.

config ASPEED_AST2500
	bool "Support Aspeed AST2500 SoC"
	select CPU_ARM1176
	select SUPPORT_SPL
	help
	  The Aspeed AST2500 is a ARM-based SoC with arm1176 CPU.
	  It is used as Board Management Controller on many server boards,
	  which is enabled by support of LPC and eSPI peripherals.

config ASPEED_AST2600
	bool "Support Aspeed AST2600 SoC"
	select CPU_V7A
	select CPU_V7_HAS_NONSEC
	select ARCH_SUPPORT_PSCI
	select SYS_ARCH_TIMER
	select SUPPORT_SPL
	select ENABLE_ARM_SOC_BOOT0_HOOK
	help
	  The Aspeed AST2600 is a ARM-based SoC with Cortex-A7 CPU.
	  It is used as Board Management Controller on many server boards,
	  which is enabled by support of LPC and eSPI peripherals.
endchoice

config ASPEED_ALLOW_DANGEROUS_BACKDOORS
	bool "Expose options enabling dangerous Aspeed hardware backdoors"
	help
	  This option exposes configuration settings that create
	  critical security vulnerabilities by enabling dangerous
	  hardware backdoors in Aspeed BMCs.  Enable it only if
	  absolutely required for a specific system or for debugging
	  during development.

if ASPEED_ALLOW_DANGEROUS_BACKDOORS

config ASPEED_ENABLE_SUPERIO
	bool "Enable built-in AST2x00 Super I/O hardware"
	depends on ASPEED_AST2400 || ASPEED_AST2500
	help
	  The Aspeed AST2400 and AST2500 include a built-in Super I/O
	  device that is normally disabled; say Y here to enable it.

	  WARNING: this has serious security implications: it grants
	  the host read access to the BMC's entire address space.
	  This should thus be left disabled unless required by a
	  specific system.

config ASPEED_ENABLE_DEBUG_UART
	bool "Enable AST2500 hardware debug UART"
	depends on ASPEED_AST2500
	help
	  The Aspeed AST2500 include a hardware-supported, UART-based
	  debug interface that is normally disabled; say Y here to
	  enable it.

	  Note that this has security implications: the debug UART
	  provides read/write access to the BMC's entire address
	  space.  This should thus be left disabled on production
	  systems, but may be useful to enable for debugging during
	  development.

endif

config ASPEED_PALLADIUM
	bool "Aspeed palladium for simulation"
	default n
	help
	  Say Y here to enable palladium build for simulation.

	  This is mainly for internal verification and investigation
	  on HW design. If not sure, say N.

config ASPEED_SSP_RERV_MEM
	hex "Reserve memory for SSP"
	default 0x0
	help
	  The size in bytes of reserve memory for ASPEED SoC SSP run.

config ASPEED_SECURE_BOOT
	bool "Support Aspeed secure boot feature"
	depends on SPL && ASPEED_AST2600
	select ENABLE_ARM_SOC_BOOT0_HOOK
	select CMD_BOOTS
	help
	  This option enables the support for secure boot.

config ASPEED_SECURE_BOOT_DEBUG
	bool "Enable debug support with secure boot"
	default y
	depends on ASPEED_SECURE_BOOT
	help
	  This option allows the bootm command use

config ASPEED_LOADERS
	bool "Aspeed custom loaders"
	depends on SPL
	default y
	help
	  Enable the custom payload loading methods used by ASPEED. This is requited to
	  use ASPEED's proprietary secure boot feature.

config ASPEED_DEFAULT_SPI_FREQUENCY
	bool "Using default SPI clock frequency"
	default n
	help
	  Using default SPI clock frequency during
	  early booting up progress.

if ASPEED_LOADERS

config ASPEED_UBOOT_MMC_PART
	int "U-Boot eMMC partition"
	default 0
	help
	  The partition number of the U-Boot
	  image in the eMMC device. This is not
	  the user data partition number.

config ASPEED_UBOOT_SPI_BASE
	hex "U-Boot SPI base address"
	default 0x0
	help
	  The base address of the U-Boot image in
	  the memory mapped SPI space

config ASPEED_UBOOT_SPI_SIZE
	hex "U-Boot SPI size in bytes"
	default 0x0
	help
	  The size in bytes of the U-Boot image in
	  the memory mapped SPI space

config ASPEED_UBOOT_MMC_BASE
	hex "U-Boot eMMC base block"
	default 0x0
	help
	  The base block number of the U-Boot
	  image in the eMMC device

config ASPEED_UBOOT_MMC_SIZE
	hex "U-Boot eMMC size in blocks"
	default 0x0
	help
	  The size in block count of the U-Boot
	  image in the eMMC device

config ASPEED_UBOOT_UART_SIZE
	hex "U-Boot UART size in bytes"
	default 0x0
	help
	  The size of U-Boot image to be recevied
	  from UART device

config ASPEED_UBOOT_DRAM_BASE
	hex "U-Boot DRAM base address"
	default 0x0
	help
	  The DRAM address where the U-Boot image
	  will be loaded if XIP is not supported

config ASPEED_KERNEL_FIT_SPI_BASE
	hex "Kernel FIT SPI base address"
	default 0x0
	help
	  The base address of the kernel FIT image in
	  the memory mapped SPI space

config ASPEED_KERNEL_FIT_SPI_SIZE
	hex "Kernel FIT SPI size in bytes"
	default 0x0
	help
	  The size in bytes of the kernel FIT image in
	  the memory mapped SPI space

config ASPEED_KERNEL_FIT_MMC_BASE
	hex "Kernel FIT eMMC base block #"
	default 0x0
	help
	  The base block number of the kernel FIT
	  image in the eMMC device

config ASPEED_KERNEL_FIT_MMC_SIZE
	hex "Kernel FIT eMMC size in blocks"
	default 0x0
	help
	  The size in block count of the kernel FIT
	  image in the eMMC device

config ASPEED_KERNEL_FIT_DRAM_BASE
	hex "Kernel FIT DRAM base address"
	default 0x0
	help
	  The DRAM address where the Kernel FIT image
	  will be loaded if XIP is not supported

endif

source "arch/arm/mach-aspeed/ast2400/Kconfig"
source "arch/arm/mach-aspeed/ast2500/Kconfig"
source "arch/arm/mach-aspeed/ast2600/Kconfig"

endif
```

## board/aspeed/ast2600_dcscm/Kconfig
```kconfig
if TARGET_AST2600_DCSCM

config SYS_BOARD
	default "ast2600_dcscm"

config SYS_VENDOR
	default "aspeed"

config SYS_CONFIG_NAME
	string "board configuration name"
	default "ast2600_dcscm"

config AVENUE_CITY_CRB
	bool "Support for Intel Avenue City CRB"
	default n

endif
```

## board/aspeed/ast2600_ibm/Kconfig
```kconfig
if TARGET_AST2600_IBM

config SYS_BOARD
	default "ast2600_ibm"

config SYS_VENDOR
	default "aspeed"

config SYS_CONFIG_NAME
	string "board configuration name"
	default "ast2600_ibm"

endif
```

## board/aspeed/evb_ast2600/Kconfig
```kconfig
if TARGET_EVB_AST2600

config SYS_BOARD
	default "evb_ast2600"

config SYS_VENDOR
	default "aspeed"

config SYS_CONFIG_NAME
	string "board configuration name"
	default "evb_ast2600"

config MACADDR_IN_EEPROM
        bool "Configure if MAC address is stored in EEPROM"
        depends on I2C_EEPROM
        default n
        help
          This option is for reading MAC address from EEPROM
          and set the MAC address in MAC env.

endif
```

## board/nvidia/gb200nvl/Kconfig
```kconfig
if TARGET_NVIDIA_GB200NVL

config SYS_BOARD
	default "gb200nvl"

config SYS_VENDOR
	default "nvidia"

config SYS_CONFIG_NAME
	string "board configuration name"
	default "gb200nvl"

endif
```

## board/nvidia/mlnxast2500bluesphere/Kconfig
```kconfig
if TARGET_MELLANOX_AST2500BLUESPHERE

config SYS_CPU
	default "arm1176"

config SYS_BOARD
	default "mlnxast2500bluesphere"

config SYS_VENDOR
	default "nvidia"

config SYS_SOC
	default "aspeed"

config SYS_CONFIG_NAME
	default "mlnxast2500bluesphere"

config FIRMWARE_2ND_BOOT
	bool "Firmware second boot WD2 enable."
endif
```

## board/qualcomm/dc-scm-v1/Kconfig
```kconfig
if TARGET_QUALCOMM_DC_SCM_V1

config SYS_BOARD
	default "dc-scm-v1"

config SYS_VENDOR
	default "qualcomm"

config SYS_SOC
	default "ast2600"

config SYS_CONFIG_NAME
	default "evb_ast2600a1_spl"

endif
```

## configs/mlnxast2500bluesphere_defconfig
```kconfig
CONFIG_ARM=y
CONFIG_TARGET_MELLANOX_AST2500BLUESPHERE=y
CONFIG_ARCH_ASPEED=y
CONFIG_ASPEED_AST2500=y
CONFIG_LOCALVERSION=" Mellanox AST2500 BlueSphere"
CONFIG_SYS_ARCH="arm"
CONFIG_SYS_CPU="arm1176"
CONFIG_SYS_SOC="aspeed"
CONFIG_SYS_VENDOR="nvidia"
CONFIG_SYS_BOARD="mlnxast2500bluesphere"
CONFIG_SYS_CONFIG_NAME="mlnxast2500bluesphere"
CONFIG_AUTOBOOT=y
CONFIG_AUTOBOOT_KEYED=y
CONFIG_AUTOBOOT_PROMPT="\nBooting the BMC in %d seconds. Type the password to stop autoboot.\n"
CONFIG_AUTOBOOT_STOP_STR="0penBmc"
CONFIG_ASPEED_NET_PHY=y
CONFIG_SPI_FLASH=y
CONFIG_SPI_FLASH_STMICRO=y
CONFIG_SPI_FLASH_WINBOND=y
CONFIG_SPI_FLASH_SPANSION=y
CONFIG_SPI_FLASH_ISSI=y
CONFIG_PHY_REALTEK=y
CONFIG_SYS_NS16550=y
CONFIG_CMD_FPGA=y
CONFIG_CMD_SAVEENV=y
CONFIG_CMD_FLASH=y
CONFIG_CMD_PING=y
CONFIG_CMD_DHCP=y
CONFIG_CMDLINE=y
CONFIG_HUSH_PARSER=y
CONFIG_SYS_PROMPT="BMC:U-Boot=> "
CONFIG_CMD_SF=y
CONFIG_BOOTDELAY=5
CONFIG_FIT=y
CONFIG_FIT_VERBOSE=y
CONFIG_NETDEVICES=y
CONFIG_OF_LIBFDT=y
CONFIG_CMD_GREPENV=y
CONFIG_CMD_MEMINFO=y
CONFIG_CMD_MII=y
CONFIG_CMD_EXT2=y
CONFIG_CMD_FAT=y
CONFIG_CMD_MTDPARTS=y
CONFIG_ENV_IS_IN_SPI_FLASH=y
CONFIG_USE_ENV_SPI_BUS=y
CONFIG_ENV_SPI_BUS=2
CONFIG_USE_ENV_SPI_CS=y
CONFIG_ENV_SPI_CS=0
CONFIG_USE_ENV_SPI_MAX_HZ=y
CONFIG_ENV_SPI_MAX_HZ=100000000
CONFIG_EXPERT=y
CONFIG_REGEX=y
CONFIG_CMD_IMI=y
CONFIG_CMD_IMLS=y
CONFIG_CMD_MEMORY=y
CONFIG_CMD_CRC32=y
CONFIG_NET_RANDOM_ETHADDR=y
CONFIG_REGMAP=y
CONFIG_SYSCON=y
CONFIG_SPL_OF_TRANSLATE=y
CONFIG_CLK=y
CONFIG_DM_GPIO=y
CONFIG_ASPEED_GPIO=y
CONFIG_DM_I2C=y
CONFIG_SYS_I2C_ASPEED=y
CONFIG_MISC=y
CONFIG_DM_MMC=y
CONFIG_DM_SPI_FLASH=y
CONFIG_DM_ETH=y
CONFIG_LOOPW=y
CONFIG_PINCTRL=y
CONFIG_CMD_MEMTEST=y
CONFIG_CMD_MX_CYCLIC=y
CONFIG_FIRMWARE_2ND_BOOT=y
CONFIG_SYS_MALLOC_F_LEN=0x6000
CONFIG_ENV_SIZE=0x20000
CONFIG_ENV_OFFSET=0x0
CONFIG_WDT_ASPEED=y
CONFIG_WDT_EARLY_BOOT=y
CONFIG_SPI=y
CONFIG_DM_SPI=y
CONFIG_DISPLAY_CPUINFO=y
CONFIG_ARCH_CPU_INIT=y
CONFIG_DM=y
CONFIG_NR_DRAM_BANKS=1

CONFIG_MTD=y

CONFIG_TIMER=y
CONFIG_WDT=y
CONFIG_SYSRESET=y
CONFIG_ASPEED_SPI=y
CONFIG_SPI_FLASH_MTD=y
CONFIG_MTD_NOR_FLASH=y
CONFIG_FLASH_CFI_DRIVER=y
CONFIG_FLASH_CFI_MTD=y
CONFIG_SYS_FLASH_CFI=y
CONFIG_I2C_EEPROM=y
CONFIG_CMD_I2C=y
CONFIG_CMD_EEPROM=y
CONFIG_SYS_I2C_EEPROM_ADDR_LEN=2
CONFIG_FIXED_PHY_APPLY=y

CONFIG_ARCH_EARLY_INIT_R=y
CONFIG_WDT_EARLY_BOOT=y
CONFIG_MACADDR_IN_EEPROM=y
CONFIG_HAS_ETH1=y
CONFIG_MISC_INIT_R=y
CONFIG_ASPEED_ECC=y
CONFIG_ASPEED_ECC_SIZE=0
```

## drivers/crypto/Kconfig
```kconfig
menu "Hardware crypto devices"

config ASPEED_HACE_V1
	bool "ASPEED Hash and Crypto Engine (V1)"
	depends on ASPEED_AST2600
	depends on !ASPEED_HACE
	depends on !ASPEED_ACRY
	imply SHA_HW_ACCEL
	imply SHA_PROG_HW_ACCEL
	imply CMD_HASH
	help
	 Select this option to enable a driver for using the SHA engine in
	 the ASPEED BMC SoCs.

	 This driver is not compatible with simultaneous operation of the ACRY
	 hardware. It should only be used when the ASPEED_HACE driver, which
	 uses accumulative mode, cannot be used.

	 Enabling this allows the use of SHA operations in hardware without
	 requiring the SHA software implementations, saving code size.

config ASPEED_HACE
	bool "ASPEED Hash and Crypto Engine"
	depends on ASPEED_AST2600
	imply SHA_HW_ACCEL
	imply SHA_PROG_HW_ACCEL
	imply CMD_HASH
	help
	 Select this option to enable a driver for using the SHA engine in
	 the ASPEED BMC SoCs.

	 Enabling this allows the use of SHA operations in hardware without requiring the
	 SHA software implementations, saving code size.

config ASPEED_ACRY
	bool "ASPEED ECC/RSA Engine"
	depends on ASPEED_AST2600
	help
	 Select this option to enable a driver for using the ECC/RSA engine in
	 the ASPEED BMC SoCs.

	 Enabling this allows the use of ECC/RSA operations in hardware without requiring the
	 software implementations, saving code size.

source drivers/crypto/fsl/Kconfig

endmenu
```

## drivers/ram/aspeed/Kconfig
```kconfig
if RAM || SPL_RAM

if ASPEED_AST2600
choice
	prompt "DDR4 target data rate"
	default ASPEED_DDR4_1600

config ASPEED_DDR4_400
	bool "DDR4 targets at 400Mbps"
	depends on DM && OF_CONTROL && ARCH_ASPEED
	help
	  select DDR4 target data rate at 400M

config ASPEED_DDR4_800
	bool "DDR4 targets at 800Mbps"
	depends on DM && OF_CONTROL && ARCH_ASPEED
	help
	  select DDR4 target data rate at 800M

config ASPEED_DDR4_1333
	bool "DDR4 targets at 1333Mbps"
	depends on DM && OF_CONTROL && ARCH_ASPEED
	help
	  select DDR4 target data rate at 1333M

config ASPEED_DDR4_1600
	bool "DDR4 targets at 1600Mbps"
	depends on DM && OF_CONTROL && ARCH_ASPEED
	help
	  select DDR4 target data rate at 1600M
endchoice

config ASPEED_DDR4_DUALX8
	bool "dual X8 DDR4 die"
	depends on DM && OF_CONTROL && ARCH_ASPEED
	default n
	help
	  select dual X8 DDR4 die

config ASPEED_BYPASS_SELFTEST
	bool "bypass self test during DRAM initialization"
	default n
	help
	  Say Y here to bypass DRAM self test to speed up the boot time
endif
endif
```
