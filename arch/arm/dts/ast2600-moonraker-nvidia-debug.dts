// SPDX-FileCopyrightText: Copyright (c) 2024 NVIDIA CORPORATION & AFFILIATES. All rights reserved.
// SPDX-License-Identifier: GPL-2.0
/*
 * Device Tree Source extras for U-Boot for the Moonraker
 */
/dts-v1/;

#include "ast2600-moonraker-nvidia.dts"  // Inherit from the original DTS

/ {
	// Delete the inherited config block
	/delete-node/ config;
};
