// SPDX-FileCopyrightText: Copyright (c) 2024 NVIDIA CORPORATION & AFFILIATES. All rights reserved.
// SPDX-License-Identifier: GPL-2.0
/*
 * Device Tree Source extras for U-Boot for the BlueSphere
 */
#include "ast2500-bluesphere-nvidia.dts"  // Inherit from the base DTS

/ {
	// Delete the inherited config block
	/delete-node/ config;
};
